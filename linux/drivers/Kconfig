## linux/drivers/Kconfig
```kconfig
config PRODOCK
    bool "Tang Mega 138K Pro Dock console drivers"
    depends on OF && SPI && FB
    select FB_SYSMEM_HELPERS_DEFERRED
    select FB_CFB_FILLRECT
    select FB_CFB_COPYAREA
    select FB_CFB_IMAGEBLIT
    select FB_TILEBLITTING
    help
      ATCSPI200 SPI/MMC and C37 GPU with fbdev and exclusive accelerator API.
      No competing firmware runs while Linux owns the peripherals.
config PRODOCK_KUNIT_TEST
    bool "Pro Dock GPU memory boundary tests"
    depends on PRODOCK && KUNIT
config NEO_GAMEPADS
    bool "Tang Neo FPGA USB gamepad ports"
    depends on OF && INPUT
    help
      Expose the two FPGA USB low-speed hosts as Linux input devices.
      Supports the captured HID 081f:e401 report format.
```

## linux/uboot/overlay/board/prodock/console/Kconfig
```kconfig
if TARGET_PRODOCK_CONSOLE
config SYS_CPU
	default "generic"
config SYS_BOARD
	default "console"
config SYS_VENDOR
	default "prodock"
config SYS_CONFIG_NAME
	default "prodock-console"
config BOARD_SPECIFIC_OPTIONS
	def_bool y
	select GENERIC_RISCV
	select ANDES_PLMT_TIMER if RISCV_MMODE
endif
```

## linux/uboot/overlay/configs/prodock_console_defconfig
```kconfig
CONFIG_RISCV=y
CONFIG_TARGET_PRODOCK_CONSOLE=y
CONFIG_TEXT_BASE=0x06000000
CONFIG_SYS_MALLOC_LEN=0x100000
CONFIG_NR_DRAM_BANKS=1
CONFIG_HAS_CUSTOM_SYS_INIT_SP_ADDR=y
CONFIG_CUSTOM_SYS_INIT_SP_ADDR=0x07000000
CONFIG_DEFAULT_DEVICE_TREE="prodock-console"
CONFIG_SYS_MONITOR_LEN=8388608
CONFIG_SYS_LOAD_ADDR=0x10000000
CONFIG_ENV_SIZE=0x2000
CONFIG_BOOTDELAY=3
CONFIG_USE_BOOTCOMMAND=y
CONFIG_BOOTCOMMAND="bootmenu 5"
CONFIG_CMD_BOOTMENU=y
CONFIG_SYS_PROMPT="PRODOCK => "
CONFIG_HUSH_PARSER=y
CONFIG_CMD_MMC=y
CONFIG_CMD_FAT=y
CONFIG_CMD_FS_GENERIC=y
CONFIG_DOS_PARTITION=y
CONFIG_ENV_IS_NOWHERE=y
# CONFIG_NET is not set
CONFIG_NO_NET=y
# CONFIG_CMD_NET is not set
# CONFIG_SMP is not set
# CONFIG_RISCV_ACLINT is not set
# CONFIG_SYS_ICACHE_OFF is not set
# CONFIG_SYS_DCACHE_OFF is not set
CONFIG_BAUDRATE=115200
CONFIG_SYS_NS16550=y
CONFIG_SPI=y
CONFIG_DM_SPI=y
CONFIG_PRODOCK_SPI=y
CONFIG_MMC=y
CONFIG_MMC_SPI=y
CONFIG_MMC_SPI_CRC_ON=y
# CONFIG_MMC_WRITE is not set
CONFIG_TIMER=y
CONFIG_ANDES_PLMT_TIMER=y
# CONFIG_CMD_SAVEENV is not set
# CONFIG_EFI_LOADER is not set
# CONFIG_EFI_PARTITION is not set
# CONFIG_CMD_BOOTEFI is not set
```
